/* charybdis_trackball_processors.dtsi */

#include <dt-bindings/zmk/input_transform.h>
#include <input/processors.dtsi>

#define CHARYBDIS_TRACKBALL_PROCESSORS \
    scroll { \
        layers = <4>; \
        input-processors = <&zip_xy_transform (INPUT_TRANSFORM_Y_INVERT)>, <&zip_xy_scaler 1 40>, <&zip_xy_to_scroll_mapper>; \
    }; \
    \
    snipe { \
        layers = <3>; \
        input-processors = <&zip_xy_scaler 1 3>; \
    }; \
    \
    /* MOVED ABOVE MOVE_BASE: Checked first when navigating active layer stacks */ \
    move_layers { \
        layers = <1 2>; \
        input-processors = <&zip_xy_scaler 3 2>; \
    }; \
    \
    /* BASE CATCH-ALL: Checked last so it only fires if higher layers aren't active */ \
    move_base { \
        layers = <0>; \
        input-processors = <&zip_xy_scaler 3 2>, <&zip_temp_layer 5 500>; \
    };
