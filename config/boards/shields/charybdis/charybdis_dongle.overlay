/*
 * charybdis_dongle.overlay — USB central
 *
 * Drives a Sinowealth SH1106 1.3" OLED (128×64) via pro_micro_i2c.
 * Wiring (Nice!Nano v2 → OLED):
 * VCC → 3.3 V   GND → GND   SDA → D2 (P0.17)   SCL → D3 (P0.20)
 */

#include <zephyr/dt-bindings/input/input-event-codes.h>
#include "charybdis.dtsi"
#include "charybdis_trackball_processors.dtsi"

/ {
    chosen {
        zmk,kscan = &mock_kscan;
        zephyr,display = &oled;
    };

    /* Clean, basic mock scanner definition */
    mock_kscan: kscan {
        compatible = "zmk,kscan-mock";
        columns = <0>;
        rows = <0>;
        events = <0>;
    };

    /* ── RECEIVE TRACKBALL CHANNELS FROM PERIPHERAL OVER THE AIR ── */
    input_split_0: input_split_0@0 {
        compatible = "zmk,input-split";
        status = "okay";
        reg = <0 1>;  /* address 0, size 1 */
    };

    /* CHANGED HERE: Renamed node from input_split_listener to input_listener */
    input_listener: input_listener {
        compatible = "zmk,input-listener";
        status = "okay";
        device = <&input_split_0>;

        /* Pulls in scroll, snipe, move (layers 1-2), and move_automouse (layer 0) cleanly! */
        CHARYBDIS_TRACKBALL_PROCESSORS
    };
};

/* ── SHUT DOWN THE PHYSICAL SPI MASTER ON THE DONGLE CLEANLY ── */
&spi0 {
    status = "disabled"; 
};

/* ── STRIP MATRIX REQUIREMENTS BUT KEEP NODE LOGIC FOR ORDINALS ── */
&kscan0 {
    /delete-property/ diode-direction;
    /delete-property/ row-gpios;
    /delete-property/ col-gpios;
};

/* ── SH1106 1.3" OLED on pro_micro_i2c ────────────────────────────────── */
&pinctrl {
    i2c0_default: i2c0_default {
        group1 {
            psels = <NRF_PSEL(TWIM_SDA, 0, 17)>,
                <NRF_PSEL(TWIM_SCL, 0, 20)>;
        };
    };

    i2c0_sleep: i2c0_sleep {
        group1 {
            psels = <NRF_PSEL(TWIM_SDA, 0, 17)>,
                <NRF_PSEL(TWIM_SCL, 0, 20)>;
            low-power-enable;
        };
    };	
}; 

&pro_micro_i2c {
    status = "okay";
    compatible = "nordic,nrf-twi";
    pinctrl-0 = <&i2c0_default>;
    pinctrl-1 = <&i2c0_sleep>;
    oled: sh1106@3c {
        compatible = "sinowealth,sh1106";
        reg = <0x3c>;
        width = <129>;
        height = <64>;
        segment-offset = <1>;
        page-offset = <0>;
        display-offset = <0>;
        multiplex-ratio = <63>;
        segment-remap;
        com-invdir;
        inversion-on;
        prechargep = <0x22>;
    };
};
